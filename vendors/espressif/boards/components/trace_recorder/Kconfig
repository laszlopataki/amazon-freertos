## vendors/espressif/boards/components/trace_recorder/Kconfig
```kconfig
menu "Trace Recorder"
    
config TRACE_RECORDER_ENABLE
    bool "Enable trace recorder component."
    default y
    help
            This enable Percepio Trace Recorder component named.
endmenu
```
